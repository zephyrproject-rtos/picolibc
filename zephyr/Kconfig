## zephyr/Kconfig
```kconfig
# Copyright © 2021 Amazon.com, Inc. or its affiliates.
# SPDX-License-Identifier: Apache-2.0

config PICOLIBC_USE_MODULE
	bool
	help
	  This setting enables building of Picolibc as a module.
	  It is used by the picolibc build system but made promptless here in
	  order to allow the build system integrating the Picolibc module to
	  decide how and under which conditions Picolibc should be enabled.
```
